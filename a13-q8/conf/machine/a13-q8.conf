## a13-q8/conf/machine/a13-q8.conf
```bitbake
#@TYPE: Machine
#@NAME: Q8 Tablet
#@DESCRIPTION: 

require conf/machine/include/sun5i.inc

KERNEL_DEVICETREE = "sun5i-a13-q8-tablet.dtb"
UBOOT_MACHINE = "q8_a13_tablet_defconfig"

PREFERRED_PROVIDER_u-boot="u-boot"
PREFERRED_PROVIDER_virtual/bootloader="u-boot"
PREFERRED_PROVIDER_virtual/kernel="linux"
PREFERRED_VERSION_linux = "${LINUX_LIBC_HEADERS_VERSION}"
```

## a13-q8/conf/machine/q8.conf
```bitbake
#@TYPE: Machine
#@NAME: Q8 Tablet
#@DESCRIPTION: 

require conf/machine/include/sun5i.inc

KERNEL_DEVICETREE = "sun5i-a13-q8-tablet.dtb"
UBOOT_MACHINE = "q8_a13_tablet_defconfig"
#UBOOT_MACHINE = "Forfun_Q88DB_config"
#SUNXI_FEX_FILE = "sys_config/a13/forfun_q88db.fex"

PREFERRED_VERSION_linux="4.8.6"

# TODO : move to local.conf
PREFERRED_PROVIDER_u-boot="u-boot"
PREFERRED_PROVIDER_virtual/bootloader="u-boot"
PREFERRED_PROVIDER_virtual/kernel="linux"
```

## a33-q8/conf/machine/a33-q8-1024x600.conf
```bitbake
#@TYPE: Machine
#@NAME: A33 Q8 Tablet
#@DESCRIPTION: 

require conf/machine/include/sun8i.inc

KERNEL_DEVICETREE = "sun8i-a33-q8-tablet.dtb"
UBOOT_MACHINE = "q8_a33_tablet_1024x600_defconfig"

PREFERRED_PROVIDER_u-boot="u-boot"
PREFERRED_PROVIDER_virtual/bootloader="u-boot"
PREFERRED_PROVIDER_virtual/kernel="linux"
PREFERRED_VERSION_linux = "${LINUX_LIBC_HEADERS_VERSION}"
```

## wintab586/conf/machine/wintab586.conf
```bitbake
# Copyright (C) 2007, Stelios Koroneos - Digital OPSiS, All Rights Reserved
# Released under the MIT license (see packages/COPYING)
#@TYPE: Machine
#@NAME: wintab586
#@DESCRIPTION: Machine configuration for a Linux running on x86 compatible machines

require conf/machine/include/tune-i586.inc

TARGET_ARCH = "i586"
TUNE_ARCH = "i586"

PREFERRED_PROVIDER_virtual/kernel = "linux"
PREFERRED_PROVIDER_virtual/xserver = "xserver-xorg"

PREFERRED_VERSION_linux-libc-headers = "${LINUX_LIBC_HEADERS_VERSION}"
PREFERRED_VERSION_linux-libc-headers-native = "${LINUX_LIBC_HEADERS_VERSION}"
PREFERRED_VERSION_linux-libc-headers-nativesdk = "${LINUX_LIBC_HEADERS_VERSION}"
PREFERRED_VERSION_linux-cocon486 = "${LINUX_LIBC_HEADERS_VERSION}"

KERNEL_IMAGETYPE = "bzImage"

MACHINE_EXTRA_RRECOMMENDS = "kernel-modules"
#TARGET_VENDOR = "-pc"
MACHINE_FEATURES = "nfs ipv4 ipv6 wifi alsa ext2 vfat pcmcia usbhost pci largefile nls xattr x86 x11 argp opengl udev pcbios"

udevdir = "/dev"
```
